## sdkconfig.defaults
```kconfig
CONFIG_IDF_TARGET="esp32s3"
# OTA rollback: if app never calls esp_ota_mark_app_valid_cancel_rollback(),
# bootloader auto-reverts to previous firmware on next power cycle.
CONFIG_BOOTLOADER_APP_ROLLBACK_ENABLE=y
CONFIG_ESP_DEFAULT_CPU_FREQ_MHZ_240=y

# Redirect console to USB Serial/JTAG (IO19/IO20), freeing UART0 for user use
CONFIG_ESP_CONSOLE_USB_SERIAL_JTAG=y

# Use -O0 to avoid GCC ICE in esp_lcd_panel_rgb.c with xtensa-esp-elf-15.2.0
CONFIG_COMPILER_OPTIMIZATION_NONE=y
# W25Q128 = 16MB flash
CONFIG_ESPTOOLPY_FLASHSIZE_16MB=y
CONFIG_ESPTOOLPY_FLASHSIZE="16MB"

# Custom 3MB factory partition (partitions.csv)
CONFIG_PARTITION_TABLE_CUSTOM=y
CONFIG_PARTITION_TABLE_CUSTOM_FILENAME="partitions.csv"

CONFIG_FREERTOS_HZ=1000
CONFIG_FREERTOS_USE_TRACE_FACILITY=y
CONFIG_FREERTOS_GENERATE_RUN_TIME_STATS=y
CONFIG_ESP_TASK_WDT_TIMEOUT_S=10

# WiFi
CONFIG_ESP_WIFI_SOFTAP_SUPPORT=y
CONFIG_ESP_WIFI_STATIC_RX_BUFFER_NUM=10
CONFIG_ESP_WIFI_DYNAMIC_RX_BUFFER_NUM=32

# HTTP Server
CONFIG_HTTPD_MAX_REQ_HDR_LEN=1024
CONFIG_HTTPD_MAX_URI_LEN=512
CONFIG_HTTPD_WS_SUPPORT=y
CONFIG_HTTPD_MAX_OPEN_SOCKETS=7

# TWAI (CAN)
CONFIG_TWAI_ISR_IN_IRAM=y

# mDNS
CONFIG_MDNS_MAX_SERVICES=5

# Logging
CONFIG_LOG_DEFAULT_LEVEL_INFO=y
```
